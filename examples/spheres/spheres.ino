#include <uVGA.h>

uVGA uvga;
int fb_width, fb_height;

#define UVGA_240M_452X200
#include <uVGA_valid_settings.h>

uint8_t sphere[][256] = {
								// red sphere
								{ 0x00, 0x00, 0x20, 0x20, 0x20, 0x40, 0x00, 0x00, 
								  0x00, 0x20, 0x20, 0x20, 0x60, 0xE0, 0x60, 0x00, 
								  0x20, 0x20, 0x20, 0x20, 0x40, 0xA0, 0x40, 0x20, 
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								  0x00, 0x00, 0x20, 0x40, 0x40, 0x40, 0x00, 0x00, 
								   },
								// green sphere
								{ 0x00, 0x00, 0x04, 0x04, 0x04, 0x08, 0x00, 0x00, 
								  0x00, 0x04, 0x04, 0x04, 0x0C, 0x1C, 0x0C, 0x00, 
								  0x04, 0x04, 0x04, 0x04, 0x08, 0x14, 0x08, 0x04, 
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								  0x00, 0x00, 0x04, 0x08, 0x08, 0x08, 0x00, 0x00, 
								   },
								// blue sphere
								{ 0x00, 0x00, 0x00, 0x00, 0x00, 0x01, 0x00, 0x00, 
								  0x00, 0x00, 0x00, 0x00, 0x01, 0x03, 0x01, 0x00, 
								  0x00, 0x00, 0x00, 0x00, 0x01, 0x02, 0x01, 0x00, 
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								  0x00, 0x00, 0x00, 0x01, 0x01, 0x01, 0x00, 0x00, 
								   },
								// cyan sphere
								{ 0x00, 0x00, 0x04, 0x04, 0x04, 0x09, 0x00, 0x00, 
								  0x00, 0x04, 0x04, 0x04, 0x0D, 0x1F, 0x0D, 0x00, 
								  0x04, 0x04, 0x04, 0x04, 0x09, 0x16, 0x09, 0x04, 
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								  0x00, 0x00, 0x04, 0x09, 0x09, 0x09, 0x00, 0x00, 
								   },
								// magenta sphere
								{ 0x00, 0x00, 0x20, 0x20, 0x20, 0x41, 0x00, 0x00, 
								  0x00, 0x20, 0x20, 0x20, 0x61, 0xE3, 0x61, 0x00, 
								  0x20, 0x20, 0x20, 0x20, 0x41, 0xA2, 0x41, 0x20, 
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								  0x00, 0x00, 0x20, 0x41, 0x41, 0x41, 0x00, 0x00, 
								   },
								// yellow sphere
								{ 0x00, 0x00, 0x24, 0x24, 0x24, 0x48, 0x00, 0x00, 
								  0x00, 0x24, 0x24, 0x24, 0x6C, 0xFC, 0x6C, 0x00, 
								  0x24, 0x24, 0x24, 0x24, 0x48, 0xB4, 0x48, 0x24, 
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								  0x00, 0x00, 0x24, 0x48, 0x48, 0x48, 0x00, 0x00, 
								   },
								// grey sphere
								{ 0x00, 0x00, 0x24, 0x24, 0x24, 0x49, 0x00, 0x00, 
								  0x00, 0x24, 0x24, 0x24, 0x6D, 0xFF, 0x6D, 0x00, 
								  0x24, 0x24, 0x24, 0x24, 0x49, 0xB6, 0x49, 0x24, 
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								  0x00, 0x00, 0x24, 0x49, 0x49, 0x49, 0x00, 0x00, 
								   }
							};

void setup()
{
	int ret; 
	ret = uvga.begin(&modeline);

	Serial.println(ret);

	if(ret != 0)
	{
		Serial.println("fatal error");
		while(1);
	}

	uvga.get_frame_buffer_size(&fb_width, &fb_height);
}

void loop()
{
	float pi = 3.14159;
	float deg2rad = pi / 180;
	char txt[5];

	float xang[25];
	float yang[25];
	int i;
	int step;
	int max_color = 6;
	int nb_spheres = 1;
	int x, y;
	int cx = fb_width / 2 + 4;
	int cy = fb_height / 2 + 4;
	int cw = fb_width / 2 - 8;
	int ch = fb_height / 2 - 8;

	xang[0] = 0;
	yang[0] = 0;

	for(i = 1; i < 25; i++)
	{
		xang[i] = xang[i-1] + 1.17;
		yang[i] = yang[i-1] + 1.39;
	}

	step = 0;

	txt[0] = '1';
	txt[1] = '\0';

	while(1)
	{
		uvga.waitSync();

		uvga.clear(0);
		for(i = nb_spheres - 1; i >= 0; i--)
		{
			int modu = (step + i) % 25;
			int integ = (step + i) / 25;

			x = cw * sinf((xang[modu] + (i + integ) * (25 * 1.17)) * deg2rad * 0.75);
			y = ch * cosf((yang[modu] + (i + integ) * (25 * 1.39)) * deg2rad * 0.67);
			uvga.drawBitmap(x + cx - 8 , y + cy - 8, sphere[max_color], 8, 8);
		}

		uvga.drawText("Spheres:", 0, fb_height - 20, 0xFF, 0, UVGA_DIR_RIGHT);
		uvga.drawText(txt, 0, fb_height - 8, 0xFF, 0, UVGA_DIR_RIGHT);

		step++;

		if(step == 25)
		{
			int p;
			int n;
			bool out = false;

			step = 0;
			nb_spheres++;

			p = 0;
			n = nb_spheres;
			if(n >= 1000)
			{
				txt[p++] = '0' + n / 1000;
				n %= 1000;
				out = true;
			}
			if((n >= 100) || out)
			{
				txt[p++] = '0' + n / 100;
				n %= 100;
				out = true;
			}
			if((n >= 10) || out)
			{
				txt[p++] = '0' + n / 10;
				n %= 10;
			}
			txt[p++] = '0' + n;
			txt[p] = '\0';
		}

	}
}
